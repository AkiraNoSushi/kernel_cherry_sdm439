## drivers/staging/android/Kconfig
```kconfig
menu "Android"

if ANDROID

config ASHMEM
	bool "Enable the Anonymous Shared Memory Subsystem"
	default n
	depends on SHMEM
	---help---
	  The ashmem subsystem is a new shared memory allocator, similar to
	  POSIX SHM but with different behavior and sporting a simpler
	  file-based API.

	  It is, in theory, a good memory allocator for low-memory devices,
	  because it can discard shared memory units when under memory pressure.

config ANDROID_VSOC
	tristate "Android Virtual SoC support"
	default n
	depends on PCI_MSI
	---help---
	  This option adds support for the Virtual SoC driver needed to boot
	  a 'cuttlefish' Android image inside QEmu. The driver interacts with
	  a QEmu ivshmem device. If built as a module, it will be called vsoc.

config ANDROID_LMK_NOTIFY_TRIGGER
	bool "Android Low Memory Killer Notify Trigger"
	depends on ANDROID_LOW_MEMORY_KILLER
	default n
	---help---
	Create node "/sys/kernel/mm/lowmemkiller/notify_trigger_active",
	on which an userspace application can poll for notification when
	the number of free physical memory pages in the system falls below
	a set threshold. The threshold is set by the new module parameter
	"/sys/module/lowmemorykiller/parameters/notify_trigger".

source "drivers/staging/android/ion/Kconfig"

endif # if ANDROID

endmenu
```
